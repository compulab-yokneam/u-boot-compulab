// SPDX-License-Identifier: (GPL-2.0+ OR MIT)
/*
 * Copyright 2026 CompuLab
 */

#include "ucm-imx8m-plus.dtsi"
#include "sb-iotgimx8pv2.dtsi"

/ {
	model = "CompuLab IOT-GATE-IMX8PV2";
	compatible = "compulab,iot-gate-imx8pv2", "compulab,iot-gate-imx8plus", "compulab,ucm-imx8m-plus-som", "fsl,imx8mp";
};
