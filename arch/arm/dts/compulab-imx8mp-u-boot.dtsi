// SPDX-License-Identifier: (GPL-2.0+ OR MIT)
/* Copyright 2026 CompuLab */

#include "imx8mp-u-boot.dtsi"

/* Program the video PLL before the shared display clock dividers. */
&media_blk_ctrl {
	assigned-clocks = <&clk IMX8MP_VIDEO_PLL1>,
			  <&clk IMX8MP_CLK_MEDIA_AXI>,
			  <&clk IMX8MP_CLK_MEDIA_APB>,
			  <&clk IMX8MP_CLK_MEDIA_DISP1_PIX>,
			  <&clk IMX8MP_CLK_MEDIA_DISP2_PIX>,
			  <&clk IMX8MP_CLK_MEDIA_ISP>,
			  <&clk IMX8MP_CLK_MEDIA_LDB>;
	assigned-clock-parents = <0>,
				 <&clk IMX8MP_SYS_PLL2_1000M>,
				 <&clk IMX8MP_SYS_PLL1_800M>,
				 <&clk IMX8MP_VIDEO_PLL1_OUT>,
				 <&clk IMX8MP_VIDEO_PLL1_OUT>,
				 <&clk IMX8MP_SYS_PLL2_500M>,
				 <&clk IMX8MP_VIDEO_PLL1_OUT>;
	assigned-clock-rates = <594000000>, <500000000>,
			       <200000000>, <0>, <42428571>,
			       <500000000>, <297000000>;
};
