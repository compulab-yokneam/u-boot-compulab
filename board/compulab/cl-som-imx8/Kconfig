## board/compulab/cl-som-imx8/Kconfig
```kconfig
if TARGET_CL_SOM_IMX8

config DEFAULT_DTB
    string "U-Boot Default Device Tree File"
    depends on TARGET_CL_SOM_IMX8
    default "sbc-imx8.dtb"

config SYS_BOARD
	default "cl-som-imx8"

config SYS_VENDOR
	default "compulab"

config SYS_CONFIG_NAME
	default "cl-som-imx8"

endif
```

## board/compulab/iot-gate-imx8plus/Kconfig
```kconfig
if TARGET_IOT_GATE_IMX8PLUS

config SYS_BOARD
	default "iot-gate-imx8plus"

config SYS_VENDOR
	default "compulab"

config SYS_CONFIG_NAME
	default "iot-gate-imx8plus"

config DEFAULT_DTB
	string
	default "iot-gate-imx8plus.dtb"

config DEFAULT_FDT_FILE
	default "iot-gate-imx8plus.dtb"

config DEFAULT_DEVICE_TREE
	default "iot-gate-imx8plus"

config SYS_I2C_EEPROM_BUS
	int
	default 1

config SYS_I2C_EEPROM_ADDR
	hex
	default 0x50

config SYS_I2C_EEPROM_BUS_SB
	hex
	default 0x1

config SYS_I2C_EEPROM_ADDR_SB
	hex
	default 0x54

endif
```

## board/compulab/iotdin-imx8p/Kconfig
```kconfig
if TARGET_IOTDIN_IMX8P

config SYS_BOARD
	default "iotdin-imx8p"

config SYS_VENDOR
	default "compulab"

config SYS_CONFIG_NAME
	default "iotdin-imx8p"

config DEFAULT_DTB
	string
	default "iotdin-imx8p.dtb"

config DEFAULT_FDT_FILE
	default "iotdin-imx8p.dtb"

config DEFAULT_DEVICE_TREE
	default "iotdin-imx8p"

config SYS_I2C_EEPROM_BUS
	int
	default 1

config SYS_I2C_EEPROM_ADDR
	hex
	default 0x50

config SYS_I2C_EEPROM_BUS_SB
	hex
	default 0x4

config SYS_I2C_EEPROM_ADDR_SB
	hex
	default 0x50

endif
```

## board/compulab/mcm-imx8m-mini/Kconfig
```kconfig
if TARGET_MCM_IMX8M_MINI

config SYS_BOARD
	default "mcm-imx8m-mini"

config SYS_VENDOR
	default "compulab"

config SYS_CONFIG_NAME
	default "mcm-imx8m-mini"

config DEFAULT_DTB
	depends on TARGET_MCM_IMX8M_MINI
	default "sbc-mcm-imx8m-mini.dtb"

endif
```

## board/compulab/plat/imx8mp/u-boot.its
```
/dts-v1/;

/ {
	description = "Configuration to load ATF and TEE before U-Boot";

	images {
		uboot@1 {
			description = "U-Boot (64-bit)";
			os = "u-boot";
			data = /incbin/("u-boot-nodtb.bin");
			type = "standalone";
			arch = "arm64";
			compression = "none";
			load = <0x40200000>;
		};
		fdt@1 {
			description = "Device Tree";
			data = /incbin/("u-boot.dtb");
			type = "flat_dt";
			compression = "none";
		};
		atf@1 {
			description = "ARM Trusted Firmware";
			os = "arm-trusted-firmware";
			data = /incbin/("bl31.bin");
			type = "firmware";
			arch = "arm64";
			compression = "none";
			load = <0x00970000>;
			entry = <0x00970000>;
		};
		tee@1 {
			description = "TEE firmware";
			data = /incbin/("tee.bin");
			type = "firmware";
			arch = "arm64";
			compression = "none";
			load = <0x56000000>;
			entry = <0x56000000>;
		};
	};
	configurations {
		default = "config@1";

		config@1 {
			description = "NAME";
			firmware = "uboot@1";
			loadables = "atf@1", "tee@1";
			fdt = "fdt@1";
		};
	};
};
```

## board/compulab/som-imx8m-plus/Kconfig
```kconfig
if TARGET_SOM_IMX8M_PLUS

menu "som-imx8m-plus config options"

config SYS_BOARD
	default "som-imx8m-plus"

config SYS_VENDOR
	default "compulab"

config SYS_CONFIG_NAME
	default "som-imx8m-plus"

config DEFAULT_DTB
	default "sbc-som-imx8m-plus.dtb"

config DEFAULT_FDT_FILE
	default "som-imx8m-plus.dtb"

config DEFAULT_DEVICE_TREE
	default "som-imx8m-plus"

config SYS_I2C_EEPROM_BUS
	int "SOM eeprom bus address"
	default 1

config SYS_I2C_EEPROM_ADDR
	hex "SOM eeprom dev address"
	default 0x50

config SYS_I2C_EEPROM_BUS_SB
	hex "SB eeprom bus address"
	default 0x2

config SYS_I2C_EEPROM_ADDR_SB
	hex "SB eeprom dev address"
	default 0x54

endmenu

endif
```

## board/compulab/ucm-imx8m-mini/Kconfig
```kconfig
if TARGET_UCM_IMX8M_MINI

config SYS_BOARD
	default "ucm-imx8m-mini"

config SYS_VENDOR
	default "compulab"

config SYS_CONFIG_NAME
	default "ucm-imx8m-mini"

config DEFAULT_DTB
	depends on TARGET_UCM_IMX8M_MINI
	default "ucm-imx8m-mini.dtb"
# Automatic selection of fdt_file requires the variable is empty
config DEFAULT_FDT
	string
	depends on TARGET_UCM_IMX8M_MINI
	default ""
# fdt_file for specific WiFi/BT modules:
config DEFAULT_FDT_WB5 # WB5 by Laird
	string
	depends on TARGET_UCM_IMX8M_MINI
	default "ucm-imx8m-mini.dtb"

config DEFAULT_FDT_2EL #2EL by Murata
	string
	depends on TARGET_UCM_IMX8M_MINI
	default "ucm-imx8m-mini-rev1.4.dtb"

endif
```

## board/compulab/ucm-imx8m-plus/Kconfig
```kconfig
if TARGET_UCM_IMX8M_PLUS

config SYS_BOARD
	default "ucm-imx8m-plus"

config SYS_VENDOR
	default "compulab"

config SYS_CONFIG_NAME
	default "ucm-imx8m-plus"

config DEFAULT_FDT_FILE
	string
	default "ucm-imx8m-plus.dtb" if !SBEV_UCMIMX8PLUS
	default "sbev-ucmimx8plus.dtb" if SBEV_UCMIMX8PLUS

config DEFAULT_DEVICE_TREE
	default "ucm-imx8m-plus"

config SYS_I2C_EEPROM_BUS
	int
	default 1

config SYS_I2C_EEPROM_ADDR
	hex
	default 0x50

config SYS_I2C_EEPROM_BUS_SB
	hex
	default 0x1 if !SBEV_UCMIMX8PLUS
	default 0x2 if SBEV_UCMIMX8PLUS

config SYS_I2C_EEPROM_ADDR_SB
	hex
	default 0x54

config IMX_CONFIG
	default "board/freescale/imx8mp_evk/imximage-8mp-lpddr4.cfg"

config SBEV_UCMIMX8PLUS
	bool "CompuLab SBEV-UCMIMX8PLUS Support"
	default n

config COMPULAB_DEBUG_UART4
	bool "System Debug UART4"
	default n

endif
```

## board/compulab/ucm-imx93/Kconfig
```kconfig
if TARGET_UCM_IMX93

config SYS_BOARD
	default "ucm-imx93"

config SYS_VENDOR
	default "compulab"

config SYS_CONFIG_NAME
	default "ucm-imx93"

config DEFAULT_DEVICE_TREE
	default "ucm-imx93"

config DEFAULT_FDT_FILE
	default "ucm-imx93.dtb"

config ENV_IS_IN_MMC
	bool
	default y

config ENV_OFFSET
	hex
	default 0x300000

config ENV_SIZE
	hex
	default 0x4000

config TEXT_BASE
	hex
	default 0x80200000

config SPL_TEXT_BASE
	hex
	default 0x2049A000

config SPL_BSS_MAX_SIZE
	hex
	default 0x2000

config SPL_MAX_SIZE
	hex
	default 0x26000

config	SYS_CBSIZE
	int
	default 2048

config SYS_MAXARGS
	int
	default 64

config SYS_PBSIZE
	int
	default 2074

config SYS_MONITOR_LEN
	int
	default	524288

config SYS_MMC_ENV_DEV
	int
	default 0

config SYS_MMC_ENV_PART
	int
	default 1

config UCM_IMX93_LPDDR4X
	bool "Using LPDDR4X Timing and PMIC voltage"
	default y
	select IMX9_LPDDR4X
	help
	  Select the LPDDR4X timing and 0.6V VDDQ
endif
```

## drivers/video/nxp/imx/dw/Kconfig
```kconfig
config VIDEO_DW_HDMI
	bool "DW HDMI library"

config VIDEO_DW_HDMI_I2C
	bool "DW HDMI i2c ddc device"

config IMX8MP_HDMI_PAVI
	bool

config DRM_SCDC_HELPER
	bool "Enable scdc helper library"

config IMX8M_PM_DOMAINS
	bool "Enable i.MX8M pm domains driver"
	depends on POWER_DOMAIN && ARCH_IMX8M
	help
	  Enable support for manipulating NXP i.MX8MM/MN/MP on-SoC power domains via
	  requests to the ATF.

config VIDEO_IMX8MP_HDMI
	bool "i.MX8MP HDMI support"
	default n
	depends on DM_VIDEO && IMX8MP
	select DRM_SCDC_HELPER
	select VIDEO_DW_HDMI
	select VIDEO_DW_HDMI_I2C
	select PHY_SAMSUNG_HDMI
	select IMX8MP_HDMI_PAVI
	select RESET_IMX_HDMIMIX
	select DISPLAY
	select DISPLAY_DETECT
	help
	  Support for i.MX8MP HDMI controller.
```
