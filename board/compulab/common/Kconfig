## board/compulab/common/Kconfig
```kconfig
config LAB_TEMPERATURE_RANGE
	bool "Extend temperature range"
	default n
	help
		Never say yes, unless you are Compulab emploee

if TARGET_UCM_IMX95 || TARGET_UCM_IMX952

choice
	prompt "CompuLab i.MX95/i.MX952 DRAM configuration"
	default DRAM_D8

config DRAM_D8
	bool "D8 DRAM support"

config DRAM_D16
	bool "D16 DRAM support"

config DRAM_D4
	bool "D4 DRAM support"

endchoice

endif
```

## board/compulab/iot-gate-imx8/Kconfig
```kconfig
if TARGET_IOT_GATE_IMX8

config SYS_BOARD
	default "iot-gate-imx8"

config SYS_VENDOR
	default "compulab"

config SYS_CONFIG_NAME
	default "iot-gate-imx8"

config DEFAULT_FDT_FILE
	string
	depends on TARGET_IOT_GATE_IMX8
	default ""

config FASTBOOT_DEBUG
	bool
	default n
	help
	  Enable fastboot as a fallback instruction, instead of UMS

config SYS_PROMPT
	string
	default "IOT-GATE-iMX8[fb] => " if FASTBOOT_DEBUG
	default "IOT-GATE-iMX8 => " if !FASTBOOT_DEBUG
endif
```

## board/compulab/iot-gate-imx8pv2/Kconfig
```kconfig
if TARGET_IOT_GATE_IMX8PV2

config SYS_BOARD
	default "iot-gate-imx8pv2"

config SYS_VENDOR
	default "compulab"

config SYS_CONFIG_NAME
	default "iot-gate-imx8pv2"

config DEFAULT_DTB
	string
	default "iot-gate-imx8pv2.dtb"

config DEFAULT_FDT_FILE
	default "iot-gate-imx8pv2.dtb"

config DEFAULT_DEVICE_TREE
	default "iot-gate-imx8pv2"

config SYS_I2C_EEPROM_BUS
	int
	default 1

config SYS_I2C_EEPROM_ADDR
	hex
	default 0x50

config SYS_I2C_EEPROM_BUS_SB
	hex
	default 0x2

config SYS_I2C_EEPROM_ADDR_SB
	hex
	default 0x50

endif
```

## board/compulab/mcm-imx8pv2/Kconfig
```kconfig
if TARGET_MCM_IMX8PV2

config SYS_BOARD
	default "mcm-imx8pv2"

config SYS_VENDOR
	default "compulab"

config SYS_CONFIG_NAME
	default "mcm-imx8pv2"

config DEFAULT_DTB
	string
	default "mcm-imx8pv2.dtb"

config DEFAULT_FDT_FILE
	string
	default "mcm-imx8pv2.dtb"

config DEFAULT_DEVICE_TREE
	string
	default "mcm-imx8pv2"

config SYS_I2C_EEPROM_BUS
	int
	default 1

config SYS_I2C_EEPROM_ADDR
	hex
	default 0x50

# SBC-MCM8PV2 carrier EEPROM on I2C3.
config SYS_I2C_EEPROM_BUS_SB
	hex
	default 0x2

config SYS_I2C_EEPROM_ADDR_SB
	hex
	default 0x54

endif
```

## board/compulab/plat/Kconfig
```kconfig
choice
	prompt  "CompuLab i.MX8M select"

config TARGET_UCM_IMX8M_MINI
	bool "CompuLab ucm-imx8m-mini"
	select IMX8MM
	select SUPPORT_SPL
	select IMX8M_LPDDR4

config TARGET_MCM_IMX8M_MINI
	bool "CompuLab mcm-imx8m-mini"
	select IMX8MM
	select SUPPORT_SPL
	select IMX8M_LPDDR4

config TARGET_IOT_GATE_IMX8
	bool "CompuLab iot-gate-imx8"
	select IMX8MM
	select SUPPORT_SPL
	select IMX8M_LPDDR4

config TARGET_UCM_IMX8M_PLUS
	bool "CompuLab ucm-imx8m-plus"
	select IMX8MP
	select BINMAN
	select SUPPORT_SPL
	select IMX8M_LPDDR4

config TARGET_MCM_IMX8M_PLUS
	bool "CompuLab mcm-imx8m-plus"
	select IMX8MP
	select BINMAN
	select SUPPORT_SPL
	select IMX8M_LPDDR4

config TARGET_SOM_IMX8M_PLUS
	bool "CompuLab som-imx8m-plus"
	select IMX8MP
	select BINMAN
	select SUPPORT_SPL
	select IMX8M_LPDDR4

config TARGET_IOT_GATE_IMX8PLUS
	bool "CompuLab iot-gate-imx8plus"
	select IMX8MP
	select BINMAN
	select SUPPORT_SPL
	select IMX8M_LPDDR4

config TARGET_IOTDIN_IMX8P
	bool "CompuLab iotdin-imx8p"
	select IMX8MP
	select BINMAN
	select SUPPORT_SPL
	select IMX8M_LPDDR4

config TARGET_IOT_GATE_IMX8PV2
	bool "CompuLab iot-gate-imx8pv2"
	select IMX8MP
	select BINMAN
	select SUPPORT_SPL
	select IMX8M_LPDDR4
endchoice

source "board/compulab/plat/imx8mp/Kconfig"
source "board/compulab/plat/imx8mm/Kconfig"
source "board/compulab/common/Kconfig"
source "board/compulab/ucm-imx8m-mini/Kconfig"
source "board/compulab/mcm-imx8m-mini/Kconfig"
source "board/compulab/iot-gate-imx8/Kconfig"
source "board/compulab/ucm-imx8m-plus/Kconfig"
source "board/compulab/mcm-imx8m-plus/Kconfig"
source "board/compulab/som-imx8m-plus/Kconfig"
source "board/compulab/iot-gate-imx8plus/Kconfig"
source "board/compulab/iotdin-imx8p/Kconfig"
source "board/compulab/iot-gate-imx8pv2/Kconfig"
```

## board/compulab/plat/imx8mm/Kconfig
```kconfig
menu "Compulab i.MX8MM platform features"
	depends on TARGET_UCM_IMX8M_MINI || TARGET_MCM_IMX8M_MINI || TARGET_IOT_GATE_IMX8

config FASTBOOT_DEBUG
	bool "Enable peripheral mode for usb1"
	default n
	help
	  Enable using the USB1 port on the periperal mode for
          SDP/fastboot.

config SPL_REPORT_FAKE_MEMSIZE
	bool "SPL passes a fake DRAM size to U-Boot"
	default n
	help
	  SPL passes to the U-Boot a value from EEPROM instead of a real memory
	  size. For debug purposes ONLY!!!

endmenu
```

## board/compulab/plat/imx8mp/Kconfig
```kconfig
menu  "Compulab i.MX8MP platform features"
	depends on TARGET_UCM_IMX8M_PLUS

choice
	prompt  "CompuLab i.MX8MP dram options"
	default IMX8MP_DRAM_D2

config IMX8MP_DRAM_D2
	bool "Enable D2 dram support"
	help
	  If 'Y' then support for D2 is enabled

config IMX8MP_DRAM_D4
	bool "Enable D4 dram support"
	help
	  If 'Y' then support for D1 is enabled

config IMX8MP_DRAM_D1D8
	bool "Enable D1D8"
	help
	If 'Y' then support for D1 and D8 configuration is enabled

endchoice

config ATF_LOAD_ADDR
	hex
	default 0x00970000

config TEE_LOAD_ADDR
	hex
	default 0x56000000

config LAB_TEMPERATURE_RANGE_WARNING
	bool "Warn about laboratory temperature range"
	depends on LAB_TEMPERATURE_RANGE

endmenu
```

## board/compulab/plat/imx93/Kconfig
```kconfig
if TARGET_CL_IMX93

config SYS_BOARD
	default "imx93"

config SYS_VENDOR
	default "compulab/plat"

config SYS_CONFIG_NAME
	default "compulab-imx93"

config DEFAULT_DEVICE_TREE
	default "cl-imx93"

config DEFAULT_FDT_FILE
	default "cl-imx93.dtb"

endif
```

## board/compulab/ucm-imx95/Kconfig
```kconfig
if TARGET_UCM_IMX95

config SYS_BOARD
	default "ucm-imx95"

config SYS_VENDOR
	default "compulab"

config SYS_CONFIG_NAME
	default "ucm-imx95"

config DEFAULT_DEVICE_TREE
	default "ucm-imx95"

config DEFAULT_FDT_FILE
	default "ucm-imx95.dtb"

config SYS_I2C_EEPROM_BUS
	default 1

config SYS_I2C_EEPROM_ADDR
	default 0x50

config SYS_I2C_EEPROM_BUS_SB
	int
	default 2

config SYS_I2C_EEPROM_ADDR_SB
	hex
	default 0x54

config ENV_OFFSET
	hex "Environment Size"
	default 0x3F0000

config ENV_SIZE
	hex "Environment Size"
	default 0x4000

config SYS_MMC_ENV_PART
	int
	default 1

endif
```

## board/compulab/ucm-imx952/Kconfig
```kconfig
if TARGET_UCM_IMX952

config SYS_BOARD
	default "ucm-imx952"

config SYS_VENDOR
	default "compulab"

config SYS_CONFIG_NAME
	default "ucm-imx952"

config DEFAULT_DEVICE_TREE
	default "ucm-imx952"

config DEFAULT_FDT_FILE
	default "ucm-imx952.dtb"

config SYS_I2C_EEPROM_BUS
	default 1

config SYS_I2C_EEPROM_ADDR
	default 0x50

config ENV_OFFSET
	hex "Environment Size"
	default 0x3F0000

config ENV_SIZE
	hex "Environment Size"
	default 0x4000

config SYS_MMC_ENV_PART
	int
	default 1

endif
```

## configs/iot-link_defconfig
```kconfig
#include "cl-imx93-shared_defconfig"
CONFIG_TARGET_IOT_LINK=y
CONFIG_CMD_TPM=y
CONFIG_CMD_TPM_TEST=y
CONFIG_LED=y
CONFIG_SPL_LED=y
CONFIG_LED_GPIO=y
# CONFIG_DM_RNG is not set
CONFIG_TPM2_TIS_I2C=y
CONFIG_TPM=y
# CONFIG_SPL_SHA512 is not set
# CONFIG_SPL_SHA384 is not set
```
